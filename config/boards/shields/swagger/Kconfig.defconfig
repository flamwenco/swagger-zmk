## config/boards/shields/swagger/Kconfig.defconfig
```kconfig
# Copyright (c) 2023 Flamwenco
# SPDX-License-Identifier: MIT

if SHIELD_SWAGGER_LEFT

config ZMK_KEYBOARD_NAME
    default "Swagger"

config ZMK_SPLIT_ROLE_CENTRAL
    default y

endif

if SHIELD_SWAGGER_LEFT || SHIELD_SWAGGER_RIGHT

config ZMK_SPLIT
    default y

endif
```

## config/boards/shields/swagger/Kconfig.shield
```kconfig
# Copyright (c) 2023 Flamwenco
# SPDX-License-Identifier: MIT

config SHIELD_SWAGGER_LEFT
    def_bool $(shields_list_contains, swagger_left)

config SHIELD_SWAGGER_RIGHT
    def_bool $(shields_list_contains, swagger_right)
```
